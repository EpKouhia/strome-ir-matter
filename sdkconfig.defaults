## sdkconfig.defaults
```kconfig
CONFIG_ESPTOOLPY_FLASHSIZE_4MB=y

# Enable BT (NimBLE)
CONFIG_BT_ENABLED=y
CONFIG_BT_NIMBLE_ENABLED=y

# Disable BT connection reattempt
CONFIG_BT_NIMBLE_ENABLE_CONN_REATTEMPT=n

# ESP32-C6 uses Matter-over-Thread for this IR controller.
CONFIG_OPENTHREAD_ENABLED=y
CONFIG_OPENTHREAD_SRP_CLIENT=y
CONFIG_OPENTHREAD_DNS_CLIENT=y
CONFIG_OPENTHREAD_LOG_LEVEL_DYNAMIC=n
CONFIG_OPENTHREAD_LOG_LEVEL_NOTE=y
CONFIG_OPENTHREAD_CLI=n
CONFIG_ENABLE_MATTER_OVER_THREAD=y
CONFIG_THREAD_NETWORK_COMMISSIONING_DRIVER=y
CONFIG_THREAD_NETWORK_ENDPOINT_ID=0

# Keep the data model consistent: no Wi-Fi Network Commissioning on this image.
CONFIG_ENABLE_WIFI_STATION=n
CONFIG_WIFI_NETWORK_COMMISSIONING_DRIVER=n

# Thread needs full mDNS and IPv6 multicast support.
CONFIG_LWIP_IPV6_AUTOCONFIG=n
CONFIG_USE_MINIMAL_MDNS=n
CONFIG_ENABLE_EXTENDED_DISCOVERY=y

# Use a custom partition table
CONFIG_PARTITION_TABLE_CUSTOM=y
CONFIG_PARTITION_TABLE_FILENAME="partitions.csv"
CONFIG_PARTITION_TABLE_OFFSET=0xC000

# Enable chip shell
CONFIG_ENABLE_CHIP_SHELL=y

# Enable lwIP route hooks
CONFIG_LWIP_HOOK_IP6_ROUTE_DEFAULT=y
CONFIG_LWIP_HOOK_ND6_GET_GW_DEFAULT=y

# Button timings
CONFIG_BUTTON_PERIOD_TIME_MS=20
CONFIG_BUTTON_LONG_PRESS_TIME_MS=5000

# Disable SoftAP by default (valid symbol in ESP-IDF)
CONFIG_ESP_WIFI_SOFTAP_SUPPORT=n

# Enable OTA Requestor
CONFIG_ENABLE_OTA_REQUESTOR=y

# Enable HKDF in mbedtls
CONFIG_MBEDTLS_HKDF_C=y

# Increase LwIP IPv6 address number for Thread/Matter fabrics.
CONFIG_LWIP_IPV6_NUM_ADDRESSES=8
CONFIG_LWIP_MULTICAST_PING=y

# Device is mains-powered (always-on). Do not expose ICD Management.
CONFIG_ENABLE_ICD_SERVER=n
CONFIG_SUPPORT_ICD_MANAGEMENT_CLUSTER=n

# Use the project commissionable data provider so the QR/manual code and PASE verifier match.
CONFIG_CUSTOM_COMMISSIONABLE_DATA_PROVIDER=y

# Use project Basic Information values instead of CHIP example TEST_* strings.
# CONFIG_EXAMPLE_DEVICE_INSTANCE_INFO_PROVIDER is not set
CONFIG_CUSTOM_DEVICE_INSTANCE_INFO_PROVIDER=y
```

## sdkconfig.defaults.esp32c6
```kconfig
CONFIG_IDF_TARGET="esp32c6"

# ESP32-C6 uses Matter-over-Thread for this IR controller.
CONFIG_OPENTHREAD_ENABLED=y
CONFIG_OPENTHREAD_SRP_CLIENT=y
CONFIG_OPENTHREAD_DNS_CLIENT=y
CONFIG_OPENTHREAD_LOG_LEVEL_DYNAMIC=n
CONFIG_OPENTHREAD_LOG_LEVEL_NOTE=y
CONFIG_OPENTHREAD_CLI=n
CONFIG_ENABLE_MATTER_OVER_THREAD=y
CONFIG_THREAD_NETWORK_COMMISSIONING_DRIVER=y
CONFIG_THREAD_NETWORK_ENDPOINT_ID=0

# Keep the data model consistent: no Wi-Fi Network Commissioning on this image.
CONFIG_ENABLE_WIFI_STATION=n
CONFIG_WIFI_NETWORK_COMMISSIONING_DRIVER=n

# Thread needs full mDNS and more IPv6 address slots.
CONFIG_USE_MINIMAL_MDNS=n
CONFIG_ENABLE_EXTENDED_DISCOVERY=y
CONFIG_LWIP_IPV6_AUTOCONFIG=n
CONFIG_LWIP_IPV6_NUM_ADDRESSES=8
CONFIG_LWIP_MULTICAST_PING=y

# This controller is mains-powered, not an ICD/sleepy device.
CONFIG_ENABLE_ICD_SERVER=n
CONFIG_SUPPORT_ICD_MANAGEMENT_CLUSTER=n
```
